## config/boards/shields/card/Kconfig.shield
```kconfig
# Copyright (c) 2020 The ZMK Contributors
# SPDX-License-Identifier: MIT

config SHIELD_SKULLY_LEFT
	def_bool $(shields_list_contains,card_left)

config SHIELD_SKULLY_RIGHT
	def_bool $(shields_list_contains,card_right)

config SHIELD_SKULLY_DONGLE
	def_bool $(shields_list_contains,card_dongle)
```

## config/boards/shields/skully/Kconfig.defconfig
```kconfig
# Copyright (c) 2020 The ZMK Contributors
# SPDX-License-Identifier: MIT

config ZMK_BLE
	default y

config ZMK_USB
	default y

if SHIELD_SKULLY_LEFT || SHIELD_SKULLY_RIGHT

config ZMK_SPLIT
	default y

endif
```

## config/boards/shields/skully/Kconfig.shield
```kconfig
# Copyright (c) 2020 The ZMK Contributors
# SPDX-License-Identifier: MIT

config SHIELD_SKULLY_LEFT
	def_bool $(shields_list_contains,skully_left)

config SHIELD_SKULLY_RIGHT
	def_bool $(shields_list_contains,skully_right)
```
